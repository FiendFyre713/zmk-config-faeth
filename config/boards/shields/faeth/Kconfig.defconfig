## config/boards/shields/faeth/Kconfig.defconfig
```kconfig
if SHIELD_FAETH_LEFT

config ZMK_KEYBOARD_NAME
    default "Faeth"

config ZMK_SPLIT_ROLE_CENTRAL
    default y

endif

if SHIELD_FAETH_LEFT || SHIELD_FAETH_RIGHT

config ZMK_SPLIT
    default y

endif
```

## config/boards/shields/faeth/Kconfig.shield
```kconfig
config SHIELD_FAETH_LEFT
    def_bool $(shields_list_contains,faeth_left)

config SHIELD_FAETH_RIGHT
    def_bool $(shields_list_contains,faeth_right)
```
